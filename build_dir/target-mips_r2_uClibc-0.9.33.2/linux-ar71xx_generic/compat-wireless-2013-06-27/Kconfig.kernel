## build_dir/target-mips_r2_uClibc-0.9.33.2/linux-ar71xx_generic/compat-wireless-2013-06-27/Kconfig.kernel
```kconfig
config MIPS
    bool
    default y

config ATH79
    bool
    default y

config ATH79_MACH_ALFA_AP96
    bool
    default y

config ATH79_MACH_HORNET_UB
    bool
    default y

config ATH79_MACH_ALFA_NX
    bool
    default y

config ATH79_MACH_ALL0258N
    bool
    default y

config ATH79_MACH_ALL0315N
    bool
    default y

config ATH79_MACH_AP113
    bool
    default y

config ATH79_MACH_AP121
    bool
    default y

config ATH79_MACH_AP132
    bool
    default y

config ATH79_MACH_AP136
    bool
    default y

config ATH79_MACH_AP81
    bool
    default y

config ATH79_MACH_AP83
    bool
    default y

config ATH79_MACH_AP96
    bool
    default y

config ATH79_MACH_DB120
    bool
    default y

config ATH79_MACH_PB42
    bool
    default y

config ATH79_MACH_PB92
    bool
    default y

config ATH79_MACH_AW_NR580
    bool
    default y

config ATH79_MACH_WHR_HP_G300N
    bool
    default y

config ATH79_MACH_WLAE_AG300N
    bool
    default y

config ATH79_MACH_WZR_HP_AG300H
    bool
    default y

config ATH79_MACH_WZR_HP_G300NH
    bool
    default y

config ATH79_MACH_WZR_HP_G300NH2
    bool
    default y

config ATH79_MACH_WZR_HP_G450H
    bool
    default y

config ATH79_MACH_WP543
    bool
    default y

config ATH79_MACH_WPE72
    bool
    default y

config ATH79_MACH_DIR_505_A1
    bool
    default y

config ATH79_MACH_DIR_600_A1
    bool
    default y

config ATH79_MACH_DIR_615_C1
    bool
    default y

config ATH79_MACH_DIR_825_B1
    bool
    default y

config ATH79_MACH_DIR_825_C1
    bool
    default y

config ATH79_MACH_EW_DORIN
    bool
    default y

config ATH79_MACH_JA76PF
    bool
    default y

config ATH79_MACH_JWAP003
    bool
    default y

config ATH79_MACH_WRT160NL
    bool
    default y

config ATH79_MACH_WRT400N
    bool
    default y

config ATH79_MACH_WNDAP360
    bool
    default y

config ATH79_MACH_WNDR3700
    bool
    default y

config ATH79_MACH_WNDR4300
    bool
    default y

config ATH79_MACH_WNR2000
    bool
    default y

config ATH79_MACH_WNR2000_V3
    bool
    default y

config ATH79_MACH_OM2P
    bool
    default y

config ATH79_MACH_MR600
    bool
    default y

config ATH79_MACH_MZK_W04NU
    bool
    default y

config ATH79_MACH_MZK_W300NH
    bool
    default y

config ATH79_MACH_RW2458N
    bool
    default y

config ATH79_MACH_CAP4200AG
    bool
    default y

config ATH79_MACH_EAP7660D
    bool
    default y

config ATH79_MACH_ARCHER_C7
    bool
    default y

config ATH79_MACH_TL_MR11U
    bool
    default y

config ATH79_MACH_TL_MR3020
    bool
    default y

config ATH79_MACH_TL_MR3X20
    bool
    default y

config ATH79_MACH_TL_WA901ND
    bool
    default y

config ATH79_MACH_TL_WA901ND_V2
    bool
    default y

config ATH79_MACH_TL_WDR3500
    bool
    default y

config ATH79_MACH_TL_WDR4300
    bool
    default y

config ATH79_MACH_TL_WR703N
    bool
    default y

config ATH79_MACH_TL_WR720N_V3
    bool
    default y

config ATH79_MACH_TL_WR741ND
    bool
    default y

config ATH79_MACH_TL_WR741ND_V4
    bool
    default y

config ATH79_MACH_TL_WR841N_V1
    bool
    default y

config ATH79_MACH_TL_WR841N_V8
    bool
    default y

config ATH79_MACH_TL_WR941ND
    bool
    default y

config ATH79_MACH_TL_WR1041N_V2
    bool
    default y

config ATH79_MACH_TL_WR1043ND
    bool
    default y

config ATH79_MACH_TL_WR2543N
    bool
    default y

config ATH79_MACH_TEW_632BRP
    bool
    default y

config ATH79_MACH_TEW_673GRU
    bool
    default y

config ATH79_MACH_TEW_712BR
    bool
    default y

config ATH79_MACH_UBNT
    bool
    default y

config ATH79_MACH_UBNT_XM
    bool
    default y

config ATH79_MACH_ZCN_1523H
    bool
    default y

config ATH79_MACH_NBG460N
    bool
    default y

config ATH79_MACH_CARAMBOLA2
    bool
    default y

config ATH79_MACH_ZHONGWANG_V1
    bool
    default y

config SOC_AR71XX
    bool
    default y

config SOC_AR724X
    bool
    default y

config SOC_AR913X
    bool
    default y

config SOC_AR933X
    bool
    default y

config SOC_AR934X
    bool
    default y

config SOC_QCA955X
    bool
    default y

config ATH79_DEV_M25P80
    bool
    default y

config ATH79_DEV_AP9X_PCI
    bool
    default y

config ATH79_DEV_DSA
    bool
    default y

config ATH79_DEV_ETH
    bool
    default y

config ATH79_DEV_GPIO_BUTTONS
    bool
    default y

config ATH79_DEV_LEDS_GPIO
    bool
    default y

config ATH79_DEV_SPI
    bool
    default y

config ATH79_DEV_USB
    bool
    default y

config ATH79_DEV_WMAC
    bool
    default y

config ATH79_NVRAM
    bool
    default y

config ATH79_PCI_ATH9K_FIXUP
    bool
    default y

config PCI_AR724X
    bool
    default y

config RWSEM_GENERIC_SPINLOCK
    bool
    default y

config GENERIC_HWEIGHT
    bool
    default y

config GENERIC_CALIBRATE_DELAY
    bool
    default y

config SCHED_OMIT_FRAME_POINTER
    bool
    default y

config CEVT_R4K
    bool
    default y

config CSRC_R4K
    bool
    default y

config DMA_NONCOHERENT
    bool
    default y

config NEED_DMA_MAP_STATE
    bool
    default y

config SYS_HAS_EARLY_PRINTK
    bool
    default y

config MYLOADER
    bool
    default y

config MIPS_MACHINE
    bool
    default y

config IMAGE_CMDLINE_HACK
    bool
    default y

config CPU_BIG_ENDIAN
    bool
    default y

config SYS_SUPPORTS_BIG_ENDIAN
    bool
    default y

config IRQ_CPU
    bool
    default y

config CPU_MIPS32_R2
    bool
    default y

config SYS_HAS_CPU_MIPS32_R2
    bool
    default y

config CPU_MIPS32
    bool
    default y

config CPU_MIPSR2
    bool
    default y

config SYS_SUPPORTS_32BIT_KERNEL
    bool
    default y

config CPU_SUPPORTS_32BIT_KERNEL
    bool
    default y

config HARDWARE_WATCHPOINTS
    bool
    default y

config 32BIT
    bool
    default y

config PAGE_SIZE_4KB
    bool
    default y

config CPU_HAS_PREFETCH
    bool
    default y

config CPU_GENERIC_DUMP_TLB
    bool
    default y

config CPU_R4K_FPU
    bool
    default y

config CPU_R4K_CACHE_TLB
    bool
    default y

config MIPS_MT_DISABLED
    bool
    default y

config CPU_HAS_SYNC
    bool
    default y

config CPU_SUPPORTS_HIGHMEM
    bool
    default y

config ARCH_FLATMEM_ENABLE
    bool
    default y

config FLATMEM
    bool
    default y

config FLAT_NODE_MEM_MAP
    bool
    default y

config HAVE_MEMBLOCK
    bool
    default y

config HAVE_MEMBLOCK_NODE_MAP
    bool
    default y

config ARCH_DISCARD_MEMBLOCK
    bool
    default y

config PAGEFLAGS_EXTENDED
    bool
    default y

config VIRT_TO_BUS
    bool
    default y

config NEED_PER_CPU_KM
    bool
    default y

config HZ_100
    bool
    default y

config SYS_SUPPORTS_ARBIT_HZ
    bool
    default y

config PREEMPT_NONE
    bool
    default y

config BOOT_RAW
    bool
    default y

config LOCKDEP_SUPPORT
    bool
    default y

config STACKTRACE_SUPPORT
    bool
    default y

config IRQ_WORK
    bool
    default y

config BUILDTIME_EXTABLE_SORT
    bool
    default y

config BROKEN_ON_SMP
    bool
    default y

config SWAP
    bool
    default y

config SYSVIPC
    bool
    default y

config SYSVIPC_SYSCTL
    bool
    default y

config HAVE_GENERIC_HARDIRQS
    bool
    default y

config GENERIC_HARDIRQS
    bool
    default y

config GENERIC_IRQ_PROBE
    bool
    default y

config GENERIC_IRQ_SHOW
    bool
    default y

config IRQ_DOMAIN
    bool
    default y

config IRQ_FORCED_THREADING
    bool
    default y

config GENERIC_CLOCKEVENTS
    bool
    default y

config GENERIC_CLOCKEVENTS_BUILD
    bool
    default y

config GENERIC_CMOS_UPDATE
    bool
    default y

config TICK_ONESHOT
    bool
    default y

config HZ_PERIODIC
    bool
    default y

config HIGH_RES_TIMERS
    bool
    default y

config TICK_CPU_ACCOUNTING
    bool
    default y

config TINY_RCU
    bool
    default y

config UIDGID_CONVERTED
    bool
    default y

config UIDGID_STRICT_TYPE_CHECKS
    bool
    default y

config RELAY
    bool
    default y

config CRASHLOG
    bool
    default y

config BLK_DEV_INITRD
    bool
    default y

config CC_OPTIMIZE_FOR_SIZE
    bool
    default y

config SYSCTL
    bool
    default y

config ANON_INODES
    bool
    default y

config HOTPLUG
    bool
    default y

config KALLSYMS
    bool
    default y

config PRINTK
    bool
    default y

config BUG
    bool
    default y

config ELF_CORE
    bool
    default y

config BASE_FULL
    bool
    default y

config FUTEX
    bool
    default y

config EPOLL
    bool
    default y

config SIGNALFD
    bool
    default y

config TIMERFD
    bool
    default y

config EVENTFD
    bool
    default y

config SHMEM
    bool
    default y

config PCI_QUIRKS
    bool
    default y

config EMBEDDED
    bool
    default y

config HAVE_PERF_EVENTS
    bool
    default y

config PERF_USE_VMALLOC
    bool
    default y

config SLUB
    bool
    default y

config HAVE_OPROFILE
    bool
    default y

config HAVE_KPROBES
    bool
    default y

config HAVE_KRETPROBES
    bool
    default y

config HAVE_DMA_ATTRS
    bool
    default y

config GENERIC_SMP_IDLE_THREAD
    bool
    default y

config HAVE_CLK
    bool
    default y

config HAVE_DMA_API_DEBUG
    bool
    default y

config HAVE_ARCH_JUMP_LABEL
    bool
    default y

config ARCH_WANT_IPC_PARSE_VERSION
    bool
    default y

config HAVE_MOD_ARCH_SPECIFIC
    bool
    default y

config MODULES_USE_ELF_REL
    bool
    default y

config CLONE_BACKWARDS
    bool
    default y

config HAVE_GENERIC_DMA_COHERENT
    bool
    default y

config RT_MUTEXES
    bool
    default y

config MODULES
    bool
    default y

config MODULE_UNLOAD
    bool
    default y

config MODULE_STRIPPED
    bool
    default y

config BLOCK
    bool
    default y

config LBDAF
    bool
    default y

config PARTITION_ADVANCED
    bool
    default y

config MSDOS_PARTITION
    bool
    default y

config EFI_PARTITION
    bool
    default y

config IOSCHED_NOOP
    bool
    default y

config IOSCHED_DEADLINE
    bool
    default y

config DEFAULT_DEADLINE
    bool
    default y

config INLINE_SPIN_UNLOCK_IRQ
    bool
    default y

config INLINE_READ_UNLOCK
    bool
    default y

config INLINE_READ_UNLOCK_IRQ
    bool
    default y

config INLINE_WRITE_UNLOCK
    bool
    default y

config INLINE_WRITE_UNLOCK_IRQ
    bool
    default y

config HW_HAS_PCI
    bool
    default y

config PCI
    bool
    default y

config PCI_DOMAINS
    bool
    default y

config PCI_DISABLE_COMMON_QUIRKS
    bool
    default y

config MMU
    bool
    default y

config BINFMT_ELF
    bool
    default y

config ARCH_BINFMT_ELF_RANDOMIZE_PIE
    bool
    default y

config BINFMT_SCRIPT
    bool
    default y

config COREDUMP
    bool
    default y

config TRAD_SIGNALS
    bool
    default y

config ARCH_HIBERNATION_POSSIBLE
    bool
    default y

config ARCH_SUSPEND_POSSIBLE
    bool
    default y

config NET
    bool
    default y

config ETHERNET_PACKET_MANGLE
    bool
    default y

config PACKET
    bool
    default y

config UNIX
    bool
    default y

config INET
    bool
    default y

config IP_MULTICAST
    bool
    default y

config IP_ADVANCED_ROUTER
    bool
    default y

config IP_MULTIPLE_TABLES
    bool
    default y

config IP_ROUTE_MULTIPATH
    bool
    default y

config IP_ROUTE_VERBOSE
    bool
    default y

config IP_MROUTE
    bool
    default y

config IP_MROUTE_MULTIPLE_TABLES
    bool
    default y

config ARPD
    bool
    default y

config SYN_COOKIES
    bool
    default y

config TCP_CONG_ADVANCED
    bool
    default y

config TCP_CONG_CUBIC
    bool
    default y

config DEFAULT_CUBIC
    bool
    default y

config IPV6
    tristate
    default m

config IPV6_PRIVACY
    bool
    default y

config IPV6_MULTIPLE_TABLES
    bool
    default y

config IPV6_SUBTREES
    bool
    default y

config IPV6_MROUTE
    bool
    default y

config NETFILTER
    bool
    default y

config NETFILTER_ADVANCED
    bool
    default y

config NF_CONNTRACK
    tristate
    default m

config NF_CONNTRACK_PROCFS
    bool
    default y

config NF_CONNTRACK_FTP
    tristate
    default m

config NF_CONNTRACK_IRC
    tristate
    default m

config NF_NAT
    tristate
    default m

config NF_NAT_NEEDED
    bool
    default y

config NF_NAT_FTP
    tristate
    default m

config NF_NAT_IRC
    tristate
    default m

config NETFILTER_XTABLES
    tristate
    default m

config NETFILTER_XT_MARK
    tristate
    default m

config NETFILTER_XT_TARGET_CLASSIFY
    tristate
    default m

config NETFILTER_XT_TARGET_CT
    tristate
    default m

config NETFILTER_XT_TARGET_DSCP
    tristate
    default m

config NETFILTER_XT_TARGET_HL
    tristate
    default m

config NETFILTER_XT_TARGET_LOG
    tristate
    default m

config NETFILTER_XT_TARGET_NETMAP
    tristate
    default m

config NETFILTER_XT_TARGET_NOTRACK
    tristate
    default m

config NETFILTER_XT_TARGET_REDIRECT
    tristate
    default m

config NETFILTER_XT_TARGET_TCPMSS
    tristate
    default m

config NETFILTER_XT_MATCH_ADDRTYPE
    tristate
    default m

config NETFILTER_XT_MATCH_COMMENT
    tristate
    default m

config NETFILTER_XT_MATCH_CONNTRACK
    tristate
    default m

config NETFILTER_XT_MATCH_DSCP
    tristate
    default m

config NETFILTER_XT_MATCH_ECN
    tristate
    default m

config NETFILTER_XT_MATCH_HL
    tristate
    default m

config NETFILTER_XT_MATCH_LENGTH
    tristate
    default m

config NETFILTER_XT_MATCH_LIMIT
    tristate
    default m

config NETFILTER_XT_MATCH_MAC
    tristate
    default m

config NETFILTER_XT_MATCH_MULTIPORT
    tristate
    default m

config NETFILTER_XT_MATCH_OWNER
    tristate
    default m

config NETFILTER_XT_MATCH_PKTTYPE
    tristate
    default m

config NETFILTER_XT_MATCH_QUOTA
    tristate
    default m

config NETFILTER_XT_MATCH_STATE
    tristate
    default m

config NETFILTER_XT_MATCH_STATISTIC
    tristate
    default m

config NETFILTER_XT_MATCH_TCPMSS
    tristate
    default m

config NETFILTER_XT_MATCH_TIME
    tristate
    default m

config NF_DEFRAG_IPV4
    tristate
    default m

config NF_CONNTRACK_IPV4
    tristate
    default m

config IP_NF_IPTABLES
    tristate
    default m

config IP_NF_FILTER
    tristate
    default m

config IP_NF_TARGET_REJECT
    tristate
    default m

config NF_NAT_IPV4
    tristate
    default m

config IP_NF_TARGET_MASQUERADE
    tristate
    default m

config IP_NF_TARGET_NETMAP
    tristate
    default m

config IP_NF_TARGET_REDIRECT
    tristate
    default m

config IP_NF_MANGLE
    tristate
    default m

config IP_NF_TARGET_ECN
    tristate
    default m

config IP_NF_RAW
    tristate
    default m

config IP_NF_ARPTABLES
    tristate
    default m

config IP_NF_ARPFILTER
    tristate
    default m

config IP_NF_ARP_MANGLE
    tristate
    default m

config NF_DEFRAG_IPV6
    tristate
    default m

config NF_CONNTRACK_IPV6
    tristate
    default m

config IP6_NF_IPTABLES
    tristate
    default m

config IP6_NF_MATCH_AH
    tristate
    default m

config IP6_NF_MATCH_EUI64
    tristate
    default m

config IP6_NF_MATCH_FRAG
    tristate
    default m

config IP6_NF_MATCH_OPTS
    tristate
    default m

config IP6_NF_MATCH_IPV6HEADER
    tristate
    default m

config IP6_NF_MATCH_MH
    tristate
    default m

config IP6_NF_MATCH_RT
    tristate
    default m

config IP6_NF_FILTER
    tristate
    default m

config IP6_NF_TARGET_REJECT
    tristate
    default m

config IP6_NF_MANGLE
    tristate
    default m

config IP6_NF_RAW
    tristate
    default m

config STP
    bool
    default y

config BRIDGE
    bool
    default y

config HAVE_NET_DSA
    bool
    default y

config NET_DSA
    bool
    default y

config NET_DSA_TAG_TRAILER
    bool
    default y

config VLAN_8021Q
    bool
    default y

config LLC
    bool
    default y

config NET_SCHED
    bool
    default y

config NET_SCH_FQ_CODEL
    bool
    default y

config NET_SCH_FIFO
    bool
    default y

config BQL
    bool
    default y

config HAMRADIO
    bool
    default y

config FIB_RULES
    bool
    default y

config WIRELESS_EXT
    bool
    default y

config WEXT_CORE
    bool
    default y

config WEXT_PROC
    bool
    default y

config WEXT_SPY
    bool
    default y

config WEXT_PRIV
    bool
    default y

config STANDALONE
    bool
    default y

config PREVENT_FIRMWARE_BUILD
    bool
    default y

config FW_LOADER
    bool
    default y

config FW_LOADER_USER_HELPER
    bool
    default y

config MTD
    bool
    default y

config MTD_ROOTFS_ROOT_DEV
    bool
    default y

config MTD_ROOTFS_SPLIT
    bool
    default y

config MTD_UIMAGE_SPLIT
    bool
    default y

config MTD_REDBOOT_PARTS
    bool
    default y

config MTD_CMDLINE_PARTS
    bool
    default y

config MTD_WRT160NL_PARTS
    bool
    default y

config MTD_MYLOADER_PARTS
    bool
    default y

config MTD_TPLINK_PARTS
    bool
    default y

config MTD_BLKDEVS
    bool
    default y

config MTD_BLOCK
    bool
    default y

config MTD_CFI
    bool
    default y

config MTD_GEN_PROBE
    bool
    default y

config MTD_CFI_ADV_OPTIONS
    bool
    default y

config MTD_CFI_NOSWAP
    bool
    default y

config MTD_CFI_GEOMETRY
    bool
    default y

config MTD_MAP_BANK_WIDTH_2
    bool
    default y

config MTD_CFI_I1
    bool
    default y

config MTD_CFI_AMDSTD
    bool
    default y

config MTD_CFI_UTIL
    bool
    default y

config MTD_COMPLEX_MAPPINGS
    bool
    default y

config MTD_PHYSMAP
    bool
    default y

config MTD_M25P80
    bool
    default y

config BLK_DEV
    bool
    default y

config HAVE_IDE
    bool
    default y

config SCSI_MOD
    bool
    default y

config NETDEVICES
    bool
    default y

config MII
    bool
    default y

config TUN
    tristate
    default m

config NET_DSA_MV88E6060
    bool
    default y

config NET_DSA_MV88E6063
    bool
    default y

config NET_VENDOR_3COM
    bool
    default y

config NET_VENDOR_ADAPTEC
    bool
    default y

config NET_VENDOR_ALTEON
    bool
    default y

config NET_VENDOR_AMD
    bool
    default y

config AG71XX
    bool
    default y

config AG71XX_AR8216_SUPPORT
    bool
    default y

config NET_CADENCE
    bool
    default y

config NET_VENDOR_BROCADE
    bool
    default y

config NET_VENDOR_CHELSIO
    bool
    default y

config NET_VENDOR_CISCO
    bool
    default y

config NET_VENDOR_DEC
    bool
    default y

config NET_VENDOR_DLINK
    bool
    default y

config NET_VENDOR_EMULEX
    bool
    default y

config NET_VENDOR_EXAR
    bool
    default y

config NET_VENDOR_HP
    bool
    default y

config NET_VENDOR_INTEL
    bool
    default y

config NET_VENDOR_I825XX
    bool
    default y

config NET_VENDOR_MARVELL
    bool
    default y

config NET_VENDOR_MELLANOX
    bool
    default y

config NET_VENDOR_MICREL
    bool
    default y

config NET_VENDOR_MICROCHIP
    bool
    default y

config NET_VENDOR_MYRI
    bool
    default y

config NET_VENDOR_NATSEMI
    bool
    default y

config NET_VENDOR_8390
    bool
    default y

config NET_VENDOR_NVIDIA
    bool
    default y

config NET_VENDOR_OKI
    bool
    default y

config NET_VENDOR_QLOGIC
    bool
    default y

config NET_VENDOR_REALTEK
    bool
    default y

config NET_VENDOR_RDC
    bool
    default y

config NET_VENDOR_SEEQ
    bool
    default y

config NET_VENDOR_SILAN
    bool
    default y

config NET_VENDOR_SIS
    bool
    default y

config NET_VENDOR_SMSC
    bool
    default y

config NET_VENDOR_STMICRO
    bool
    default y

config NET_VENDOR_SUN
    bool
    default y

config NET_VENDOR_TEHUTI
    bool
    default y

config NET_VENDOR_TI
    bool
    default y

config NET_VENDOR_TOSHIBA
    bool
    default y

config NET_VENDOR_VIA
    bool
    default y

config PHYLIB
    bool
    default y

config MDIO_BOARDINFO
    bool
    default y

config SWCONFIG
    bool
    default y

config SWCONFIG_LEDS
    bool
    default y

config MARVELL_PHY
    bool
    default y

config MICREL_PHY
    bool
    default y

config IP17XX_PHY
    bool
    default y

config AR8216_PHY
    bool
    default y

config RTL8306_PHY
    bool
    default y

config RTL8366_SMI
    bool
    default y

config RTL8366S_PHY
    bool
    default y

config RTL8366RB_PHY
    bool
    default y

config RTL8367_PHY
    bool
    default y

config PPP
    tristate
    default m

config PPP_FILTER
    bool
    default y

config PPP_MULTILINK
    bool
    default y

config PPPOE
    tristate
    default m

config PPP_ASYNC
    tristate
    default m

config SLHC
    tristate
    default m

config ISDN
    bool
    default y

config TTY
    bool
    default y

config UNIX98_PTYS
    bool
    default y

config SERIAL_8250
    bool
    default y

config SERIAL_8250_CONSOLE
    bool
    default y

config SERIAL_CORE
    bool
    default y

config SERIAL_CORE_CONSOLE
    bool
    default y

config SERIAL_AR933X
    bool
    default y

config SERIAL_AR933X_CONSOLE
    bool
    default y

config DEVPORT
    bool
    default y

config I2C
    bool
    default y

config I2C_BOARDINFO
    bool
    default y

config I2C_ALGOBIT
    bool
    default y

config I2C_GPIO
    bool
    default y

config SPI
    bool
    default y

config SPI_MASTER
    bool
    default y

config SPI_AP83
    bool
    default y

config SPI_ATH79
    bool
    default y

config SPI_BITBANG
    bool
    default y

config ARCH_HAVE_CUSTOM_GPIO_H
    bool
    default y

config ARCH_REQUIRE_GPIOLIB
    bool
    default y

config GPIO_DEVRES
    bool
    default y

config GPIOLIB
    bool
    default y

config GPIO_SYSFS
    bool
    default y

config GPIO_PCF857X
    bool
    default y

config GPIO_NXP_74HC153
    bool
    default y

config WATCHDOG
    bool
    default y

config ATH79_WDT
    bool
    default y

config SSB_POSSIBLE
    bool
    default y

config BCMA_POSSIBLE
    bool
    default y

config USB_ARCH_HAS_OHCI
    bool
    default y

config USB_ARCH_HAS_EHCI
    bool
    default y

config USB_ARCH_HAS_XHCI
    bool
    default y

config USB_SUPPORT
    bool
    default y

config USB_COMMON
    tristate
    default m

config USB_ARCH_HAS_HCD
    bool
    default y

config USB
    tristate
    default m

config USB_DEFAULT_PERSIST
    bool
    default y

config USB_EHCI_HCD
    tristate
    default m

config USB_EHCI_ROOT_HUB_TT
    bool
    default y

config USB_EHCI_TT_NEWSCHED
    bool
    default y

config USB_EHCI_PCI
    tristate
    default m

config USB_EHCI_ATH79
    bool
    default y

config USB_EHCI_HCD_PLATFORM
    tristate
    default m

config USB_OHCI_HCD
    tristate
    default m

config USB_OHCI_ATH79
    bool
    default y

config USB_OHCI_HCD_PLATFORM
    bool
    default y

config USB_OHCI_LITTLE_ENDIAN
    bool
    default y

config NEW_LEDS
    bool
    default y

config LEDS_CLASS
    bool
    default y

config LEDS_GPIO
    tristate
    default m

config LEDS_TRIGGERS
    bool
    default y

config LEDS_TRIGGER_TIMER
    tristate
    default m

config LEDS_TRIGGER_DEFAULT_ON
    tristate
    default m

config LEDS_TRIGGER_NETDEV
    tristate
    default m

config LEDS_TRIGGER_USBDEV
    tristate
    default m

config RTC_LIB
    bool
    default y

config STAGING
    bool
    default y

config NET_VENDOR_SILICOM
    bool
    default y

config FILE_LOCKING
    bool
    default y

config FSNOTIFY
    bool
    default y

config INOTIFY_USER
    bool
    default y

config OVERLAYFS_FS
    bool
    default y

config PROC_FS
    bool
    default y

config PROC_SYSCTL
    bool
    default y

config PROC_STRIPPED
    bool
    default y

config SYSFS
    bool
    default y

config TMPFS
    bool
    default y

config TMPFS_XATTR
    bool
    default y

config MISC_FILESYSTEMS
    bool
    default y

config JFFS2_FS
    bool
    default y

config JFFS2_FS_WRITEBUFFER
    bool
    default y

config JFFS2_SUMMARY
    bool
    default y

config JFFS2_FS_XATTR
    bool
    default y

config JFFS2_COMPRESSION_OPTIONS
    bool
    default y

config JFFS2_LZMA
    bool
    default y

config JFFS2_RTIME
    bool
    default y

config JFFS2_CMODE_PRIORITY
    bool
    default y

config SQUASHFS
    bool
    default y

config SQUASHFS_XZ
    bool
    default y

config NETWORK_FILESYSTEMS
    bool
    default y

config NLS
    tristate
    default m

config TRACE_IRQFLAGS_SUPPORT
    bool
    default y

config PRINTK_TIME
    bool
    default y

config ENABLE_WARN_DEPRECATED
    bool
    default y

config MAGIC_SYSRQ
    bool
    default y

config STRIP_ASM_SYMS
    bool
    default y

config DEBUG_FS
    bool
    default y

config DEBUG_KERNEL
    bool
    default y

config HAVE_DEBUG_KMEMLEAK
    bool
    default y

config DEBUG_INFO
    bool
    default y

config DEBUG_INFO_REDUCED
    bool
    default y

config HAVE_FUNCTION_TRACER
    bool
    default y

config HAVE_FUNCTION_GRAPH_TRACER
    bool
    default y

config HAVE_FUNCTION_TRACE_MCOUNT_TEST
    bool
    default y

config HAVE_DYNAMIC_FTRACE
    bool
    default y

config HAVE_FTRACE_MCOUNT_RECORD
    bool
    default y

config HAVE_C_RECORDMCOUNT
    bool
    default y

config TRACING_SUPPORT
    bool
    default y

config HAVE_ARCH_KGDB
    bool
    default y

config EARLY_PRINTK
    bool
    default y

config CMDLINE_BOOL
    bool
    default y

config DEFAULT_SECURITY_DAC
    bool
    default y

config CRYPTO
    bool
    default y

config CRYPTO_ALGAPI
    bool
    default y

config CRYPTO_ALGAPI2
    bool
    default y

config CRYPTO_AEAD
    tristate
    default m

config CRYPTO_AEAD2
    tristate
    default m

config CRYPTO_BLKCIPHER
    tristate
    default m

config CRYPTO_BLKCIPHER2
    tristate
    default m

config CRYPTO_HASH
    tristate
    default m

config CRYPTO_HASH2
    tristate
    default m

config CRYPTO_RNG2
    tristate
    default m

config CRYPTO_MANAGER
    tristate
    default m

config CRYPTO_MANAGER2
    bool
    default y

config CRYPTO_MANAGER_DISABLE_TESTS
    bool
    default y

config CRYPTO_WORKQUEUE
    tristate
    default m

config CRYPTO_CRC32C
    tristate
    default m

config CRYPTO_AES
    bool
    default y

config CRYPTO_ARC4
    tristate
    default m

config CRYPTO_HW
    bool
    default y

config BITREVERSE
    bool
    default y

config NO_GENERIC_PCI_IOPORT_MAP
    bool
    default y

config GENERIC_PCI_IOMAP
    bool
    default y

config GENERIC_IO
    bool
    default y

config CRC_CCITT
    tristate
    default m

config CRC16
    tristate
    default m

config CRC32
    bool
    default y

config CRC32_SARWATE
    bool
    default y

config LIBCRC32C
    tristate
    default m

config XZ_DEC
    bool
    default y

config LZMA_COMPRESS
    bool
    default y

config LZMA_DECOMPRESS
    bool
    default y

config TEXTSEARCH
    bool
    default y

config HAS_IOMEM
    bool
    default y

config HAS_IOPORT
    bool
    default y

config HAS_DMA
    bool
    default y

config DQL
    bool
    default y

config NLATTR
    bool
    default y

config GENERIC_ATOMIC64
    bool
    default y

config ARCH_HAS_ATOMIC64_DEC_IF_POSITIVE
    bool
    default y

config AVERAGE
    bool
    default y

config HAVE_KVM
    bool
    default y
```
